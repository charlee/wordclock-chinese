/**
 * Chinese word mapping to the LED matrix
 */

#include <Arduino.h>
#include <TimeLib.h>
#include "ChineseWordMatrix.h"


/*

十一二三月  四五六七月   60 -> 69
八九月二三  十一二三日   59 <- 50
二十四五六  日七八九日   40 -> 49
早晚上中下  午十一二点   39 <- 30
两三四五点  六七八九点   20 -> 29
二三十零一  二分三四分   19 <- 10
四五十五六  分七八九分    0 ->  9

*/


const uint8_t cw_minutes[60][4] = {

  {99, 99, 99, 99},     // 00
  {16, 15, 13, 99},     // 01
  {16, 14, 13, 99},     // 02
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  { 1,  2,  8,  9},     // 59
};



/*

十一二三月  四五六七月   60 -> 69
八九月二三  十一二三日   59 <- 50
二十四五六  日七八九日   40 -> 49
早晚上中下  午十一二点   39 <- 30
两三四五点  六七八九点   20 -> 29
二三十零一  二分三四分   19 <- 10
四五十五六  分七八九分    0 ->  9

*/

const uint8_t cw_hours[24][5] = {

  {38, 37, 33, 31, 30},   // 00
  {38, 37, 32, 30, 99},   // 01
  {38, 37, 20, 24, 99},   // 02
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  {38, 37, 33, 32, 30},   // 23
};


/*

十一二三月  四五六七月   60 -> 69
八九月二三  十一二三日   59 <- 50
二十四五六  日七八九日   40 -> 49
早晚上中下  午十一二点   39 <- 30
两三四五点  六七八九点   20 -> 29
二三十零一  二分三四分   19 <- 10
四五十五六  分七八九分    0 ->  9

*/

const uint8_t cw_days[32][4] = {

  {99, 99, 99, 99},       // -
  {53, 50, 99, 99},       //  1
  {52, 50, 99, 99},       //  2
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  {55, 54, 53, 50},       // 31
};

/*

十一二三月  四五六七月   60 -> 69
八九月二三  十一二三日   59 <- 50
二十四五六  日七八九日   40 -> 49
早晚上中下  午十一二点   39 <- 30
两三四五点  六七八九点   20 -> 29
二三十零一  二分三四分   19 <- 10
四五十五六  分七八九分    0 ->  9

*/
const uint8_t cw_months[13][3] = {
  {99, 99, 99},       // -
  {61, 64, 99},       //  1
  {62, 64, 99},       //  2
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  {60, 62, 64},       // 11
};

/**
 * epoch is with offset
 */
int getLEDsByEpoch(unsigned long epoch, uint8_t* led_pos) {

  int i, count, t;

  t = month(epoch);
  count = 0;
  for (i = 0; i < 3; i++) {
    if (cw_months[t][i] == 99) break;
    led_pos[count] = cw_months[t][i];
    count++;
  }

  t = day(epoch);
  for (i = 0; i < 4; i++) {
    if (cw_days[t][i] == 99) break;
    led_pos[count] = cw_days[t][i];
    count++;
  }

  t = hour(epoch);
  for (i = 0; i < 5; i++) {
    if (cw_hours[t][i] == 99) break;
    led_pos[count] = cw_hours[t][i];
    count++;
  }

  t = minute(epoch);
  for (i = 0; i < 4; i++) {
    if (cw_minutes[t][i] == 99) break;
    led_pos[count] = cw_minutes[t][i];
    count++;
  }

  return count;
}

